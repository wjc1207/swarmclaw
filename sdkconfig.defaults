## sdkconfig.defaults
```kconfig
# MimiClaw - Common Default Configuration
# Target-specific settings are in sdkconfig.defaults.esp32s3

# WiFi + BLE coexistence
CONFIG_BT_ENABLED=y
CONFIG_BT_NIMBLE_ENABLED=y
CONFIG_BTDM_CTRL_MODE_BLE_ONLY=y
CONFIG_ESP_COEX_SW_COEXIST_ENABLE=y
```
